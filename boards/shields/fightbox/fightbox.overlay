#include <dt-bindings/gpio/gpio.h>

/ {
    chosen {
        zmk,kscan = &kscan0;
    };

    kscan0: kscan {
        compatible = "zmk,kscan-gpio-direct";

      input-gpios =
    <&gpio1 4 (GPIO_PULL_UP | GPIO_ACTIVE_LOW)>,
    <&gpio1 6 (GPIO_PULL_UP | GPIO_ACTIVE_LOW)>,
    <&gpio0 9 (GPIO_PULL_UP | GPIO_ACTIVE_LOW)>,
    <&gpio0 10 (GPIO_PULL_UP | GPIO_ACTIVE_LOW)>,
    <&gpio1 11 (GPIO_PULL_UP | GPIO_ACTIVE_LOW)>,
    <&gpio1 13 (GPIO_PULL_UP | GPIO_ACTIVE_LOW)>,
    <&gpio1 15 (GPIO_PULL_UP | GPIO_ACTIVE_LOW)>,
    <&gpio0 2 (GPIO_PULL_UP | GPIO_ACTIVE_LOW)>,
    <&gpio0 29 (GPIO_PULL_UP | GPIO_ACTIVE_LOW)>,
    <&gpio0 31 (GPIO_PULL_UP | GPIO_ACTIVE_LOW)>;
    };
};
